## Kconfig
```
menu "Modbus hello TCP sample"

config MODBUS_HELLO_SERVER_ADDR
    string "Modbus/TCP server IPv4 address"
    default "192.0.2.1"
    help
        IPv4 address of the Modbus/TCP server to connect to.

config MODBUS_HELLO_SERVER_PORT
    int "Modbus/TCP server port"
    range 1 65535
    default 502
    help
        TCP port number of the Modbus server.

config MODBUS_HELLO_POLL_INTERVAL_MS
    int "Polling interval (ms)"
    range 1 1000
    default 10
    help
        Delay in milliseconds between mb_client_poll() calls.

endmenu
```

## prj.conf
```kconfig
CONFIG_NETWORKING=y
CONFIG_NET_IPV4=y
CONFIG_NET_TCP=y
CONFIG_NET_SOCKETS=y
CONFIG_NET_SOCKETS_POSIX_NAMES=y
CONFIG_NET_CONFIG_SETTINGS=y
CONFIG_NET_CONFIG_NEED_IPV4=y
CONFIG_NET_CONFIG_INIT_TIMEOUT=0
CONFIG_NET_CONFIG_MY_IPV4_ADDR="192.0.2.2"
CONFIG_NET_CONFIG_MY_IPV4_NETMASK="255.255.255.0"
CONFIG_NET_CONFIG_MY_IPV4_GW="192.0.2.254"
CONFIG_LOG=y
CONFIG_LOG_DEFAULT_LEVEL=3
CONFIG_HEAP_MEM_POOL_SIZE=8192
CONFIG_MAIN_STACK_SIZE=2048
CONFIG_SYSTEM_WORKQUEUE_STACK_SIZE=2048
```

## src/main.c
```c
#include <zephyr/kernel.h>
#include <zephyr/logging/log.h>
#include <zephyr/net/socket.h>

#include "modbus_zephyr_quickstart.h"

LOG_MODULE_REGISTER(modbus_hello_tcp, LOG_LEVEL_INF);

static volatile bool g_request_in_flight;

static void modbus_response_cb(struct mb_client *client,
                               const struct mb_client_txn *txn,
                               mb_err_t status,
                               const mb_adu_view_t *response,
                               void *user_ctx)
{
    ARG_UNUSED(client);
    ARG_UNUSED(txn);
    ARG_UNUSED(user_ctx);

    if (mb_err_is_ok(status)) {
        LOG_INF("Received %u bytes from unit %u", response->payload_len, response->unit_id);
    } else {
        LOG_WRN("Modbus transaction failed (%d)", status);
    }

    g_request_in_flight = false;
}

static int connect_server(modbus_zephyr_client_t *client)
{
    struct sockaddr_in server = {
        .sin_family = AF_INET,
        .sin_port = htons(CONFIG_MODBUS_HELLO_SERVER_PORT),
    };

    if (zsock_inet_pton(AF_INET, CONFIG_MODBUS_HELLO_SERVER_ADDR, &server.sin_addr) != 1) {
        LOG_ERR("Invalid server address %s", CONFIG_MODBUS_HELLO_SERVER_ADDR);
        return -EINVAL;
    }

    int rc = modbus_zephyr_client_connect(client,
                                          (struct sockaddr *)&server,
                                          sizeof(server));
    if (rc != 0) {
        LOG_ERR("Failed to connect Modbus server (%d)", rc);
    }

    return rc;
}

int main(void)
{
    modbus_zephyr_client_t client;
    mb_err_t err = modbus_zephyr_client_init(&client);
    if (err != MB_OK) {
        LOG_ERR("mb_client_init failed (%d)", err);
        return 0;
    }

    if (connect_server(&client) != 0) {
        return 0;
    }

    while (1) {
        if (!g_request_in_flight) {
            err = modbus_zephyr_submit_read_holding(&client,
                                                    1,
                                                    0x0000,
                                                    2,
                                                    modbus_response_cb,
                                                    NULL);
            if (err == MB_OK) {
                g_request_in_flight = true;
                LOG_INF("Submitted FC03 read for 2 registers");
            } else {
                LOG_WRN("Queue submit failed (%d)", err);
                k_msleep(500);
            }
        }

        mb_client_poll(&client.client);
        k_msleep(CONFIG_MODBUS_HELLO_POLL_INTERVAL_MS);
    }
}
```
