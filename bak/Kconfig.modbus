## bak/Kconfig.projbuild
```kconfig
# Kconfig.projbuild - ESP-IDF menuconfig for Modbus Library
#
# This file integrates Modbus configuration into ESP-IDF's menuconfig system

menu "Modbus Configuration"

    choice MODBUS_PROFILE
        prompt "Modbus Profile"
        default MODBUS_PROFILE_LEAN
        help
            Select the Modbus feature profile:
            
            TINY  - Minimal footprint (~26KB ROM, ~8KB RAM)
            LEAN  - Balanced configuration (~40KB ROM, ~11KB RAM)
            FULL  - All features enabled (~43KB ROM, ~12KB RAM)

        config MODBUS_PROFILE_TINY
            bool "TINY - Minimal footprint"
        config MODBUS_PROFILE_LEAN
            bool "LEAN - Balanced"
        config MODBUS_PROFILE_FULL
            bool "FULL - All features"
    endchoice

    config MB_CONF_PROFILE
        int
        default 0 if MODBUS_PROFILE_TINY
        default 1 if MODBUS_PROFILE_LEAN
        default 2 if MODBUS_PROFILE_FULL

    config MB_CONF_BUILD_CLIENT
        bool "Enable Modbus Client"
        default y
        help
            Enable Modbus client (master) functionality.

    config MB_CONF_BUILD_SERVER
        bool "Enable Modbus Server"
        default y if !MODBUS_PROFILE_TINY
        default n
        help
            Enable Modbus server (slave) functionality.

    menu "Transport Layer"

        config MB_CONF_TRANSPORT_RTU
            bool "Enable RTU Transport"
            default y
            help
                Enable Modbus RTU (serial) transport.

        config MB_CONF_TRANSPORT_TCP
            bool "Enable TCP Transport"
            default y if !MODBUS_PROFILE_TINY
            default n
            help
                Enable Modbus TCP/IP transport.

        config MB_CONF_TRANSPORT_ASCII
            bool "Enable ASCII Transport"
            default n
            help
                Enable Modbus ASCII transport.

    endmenu

    menu "Function Codes"

        config MB_CONF_ENABLE_FC01
            bool "FC01 - Read Coils"
            default y if MODBUS_PROFILE_FULL
            default n

        config MB_CONF_ENABLE_FC02
            bool "FC02 - Read Discrete Inputs"
            default y if MODBUS_PROFILE_FULL
            default n

        config MB_CONF_ENABLE_FC03
            bool "FC03 - Read Holding Registers"
            default y

        config MB_CONF_ENABLE_FC04
            bool "FC04 - Read Input Registers"
            default y

        config MB_CONF_ENABLE_FC05
            bool "FC05 - Write Single Coil"
            default y if MODBUS_PROFILE_FULL
            default n

        config MB_CONF_ENABLE_FC06
            bool "FC06 - Write Single Register"
            default y

        config MB_CONF_ENABLE_FC07
            bool "FC07 - Read Exception Status"
            default y if MODBUS_PROFILE_FULL
            default n

        config MB_CONF_ENABLE_FC0F
            bool "FC15 (0x0F) - Write Multiple Coils"
            default y if MODBUS_PROFILE_FULL
            default n

        config MB_CONF_ENABLE_FC10
            bool "FC16 (0x10) - Write Multiple Registers"
            default y

        config MB_CONF_ENABLE_FC11
            bool "FC17 (0x11) - Report Server ID"
            default y if MODBUS_PROFILE_FULL
            default n

        config MB_CONF_ENABLE_FC16
            bool "FC22 (0x16) - Mask Write Register"
            default y if MODBUS_PROFILE_FULL
            default n

        config MB_CONF_ENABLE_FC17
            bool "FC23 (0x17) - Read/Write Multiple Registers"
            default y

    endmenu

    menu "Queue and Pool Settings"

        config MB_CONF_QUEUE_DEPTH
            int "Transaction Queue Depth"
            range 4 64
            default 8 if MODBUS_PROFILE_TINY
            default 16 if MODBUS_PROFILE_LEAN
            default 32 if MODBUS_PROFILE_FULL
            help
                Maximum number of pending transactions.

        config MB_CONF_MAX_PDU_SIZE
            int "Maximum PDU Size (bytes)"
            range 253 260
            default 253

        config MB_CONF_TX_POOL_SIZE
            int "TX Transaction Pool Size"
            range 4 64
            default 8 if MODBUS_PROFILE_TINY
            default 16 if MODBUS_PROFILE_LEAN
            default 32 if MODBUS_PROFILE_FULL

    endmenu

    menu "Timeouts and Timing"

        config MB_CONF_DEFAULT_TIMEOUT_MS
            int "Default Transaction Timeout (ms)"
            range 100 10000
            default 1000

        config MB_CONF_INTER_FRAME_DELAY_MS
            int "Inter-frame Delay (ms)"
            range 0 1000
            default 10

        config MB_CONF_RTU_T15_MULTIPLIER
            int "RTU T1.5 Multiplier (tenths)"
            range 10 30
            default 15
            depends on MB_CONF_TRANSPORT_RTU

        config MB_CONF_RTU_T35_MULTIPLIER
            int "RTU T3.5 Multiplier (tenths)"
            range 30 50
            default 35
            depends on MB_CONF_TRANSPORT_RTU

    endmenu

    menu "Diagnostics and Logging"

        config MB_CONF_DIAG_ENABLE_COUNTERS
            bool "Enable Diagnostic Counters"
            default y if MODBUS_PROFILE_FULL
            default n

        config MB_CONF_DIAG_ENABLE_TRACE
            bool "Enable Event Trace Buffer"
            default y if MODBUS_PROFILE_FULL
            default n

        config MB_CONF_DIAG_TRACE_DEPTH
            int "Trace Buffer Depth"
            range 16 256
            default 64
            depends on MB_CONF_DIAG_ENABLE_TRACE

        choice MB_LOG_LEVEL
            prompt "Logging Level"
            default MB_LOG_LEVEL_NONE if MODBUS_PROFILE_TINY
            default MB_LOG_LEVEL_WARN if MODBUS_PROFILE_LEAN
            default MB_LOG_LEVEL_INFO if MODBUS_PROFILE_FULL

            config MB_LOG_LEVEL_NONE
                bool "None"
            config MB_LOG_LEVEL_ERROR
                bool "Error"
            config MB_LOG_LEVEL_WARN
                bool "Warning"
            config MB_LOG_LEVEL_INFO
                bool "Info"
            config MB_LOG_LEVEL_DEBUG
                bool "Debug"
        endchoice

        config MB_CONF_LOG_LEVEL
            int
            default 0 if MB_LOG_LEVEL_NONE
            default 1 if MB_LOG_LEVEL_ERROR
            default 2 if MB_LOG_LEVEL_WARN
            default 3 if MB_LOG_LEVEL_INFO
            default 4 if MB_LOG_LEVEL_DEBUG

    endmenu

    menu "Advanced Features"

        config MB_CONF_ENABLE_POWER_MANAGEMENT
            bool "Enable Power Management"
            default n

        config MB_CONF_PORT_MUTEX
            bool "Enable Mutex Support"
            default y

        config MB_CONF_ENABLE_ISR_SAFE_MODE
            bool "Enable ISR-Safe Mode"
            default n

        config MB_CONF_ENABLE_ZERO_COPY
            bool "Enable Zero-Copy IO"
            default y if !MODBUS_PROFILE_TINY
            default n

    endmenu

endmenu
```

## bak/embedded/quickstarts/components/esp-idf/modbus/Kconfig
```kconfig
menu "Modbus quickstart"

config MODBUS_QUICKSTART_UART_PORT
    int "Default UART port"
    range 0 2
    default 1
    help
        UART controller used by the quickstart transport. Override at runtime
        by filling modbus_esp_quickstart_config_t.

config MODBUS_QUICKSTART_UART_BAUDRATE
    int "Default UART baudrate"
    default 115200
    help
        Baudrate applied during modbus_esp_quickstart_init() unless a different
        value is provided in the runtime configuration.

config MODBUS_QUICKSTART_UART_RX_BUFFER
    int "UART RX buffer size"
    default 256
    help
        Size of the ESP-IDF driver RX buffer allocated by uart_driver_install().

config MODBUS_QUICKSTART_UART_TX_BUFFER
    int "UART TX buffer size"
    default 256
    help
        Size of the ESP-IDF driver TX buffer allocated by uart_driver_install().

config MODBUS_QUICKSTART_CLIENT_POOL_SIZE
    int "Client transaction pool size"
    range 1 32
    default 4
    help
        Number of transaction descriptors allocated by the quickstart helper.
        Increase the value if you plan to queue multiple concurrent requests.

config MODBUS_QUICKSTART_CLIENT_QUEUE_CAPACITY
    int "Client queue capacity override"
    range 0 32
    default 0
    help
        Optional override for mb_client_set_queue_capacity(). Leave as zero to
        keep the queue capacity equal to the pool size.

config MODBUS_QUICKSTART_YIELD_MS
    int "Yield hint in milliseconds"
    range 0 20
    default 1
    help
        Delay used by the transport yield hook. Set to zero to call taskYIELD()
        instead of vTaskDelay().

endmenu
```

## bak/examples/esp32_rtu_client/main/Kconfig.projbuild
```kconfig
# ESP32 Modbus RTU Client Configuration
# This file is processed by idf.py menuconfig

menu "Modbus RTU Configuration"

    config MODBUS_UART_PORT
        int "UART Port Number"
        default 1
        range 0 2
        help
            UART port number for Modbus communication.
            - UART0: Usually used for console (avoid for Modbus)
            - UART1: Recommended for Modbus
            - UART2: Alternative (ESP32 only, not on ESP32-C3)

    config MODBUS_UART_TX_PIN
        int "UART TX Pin"
        default 17
        help
            GPIO pin for UART TX (transmit).
            Default: GPIO17 (UART1 on ESP32)
            ESP32-C3: Adjust to available pins (e.g., GPIO7)

    config MODBUS_UART_RX_PIN
        int "UART RX Pin"
        default 16
        help
            GPIO pin for UART RX (receive).
            Default: GPIO16 (UART1 on ESP32)
            ESP32-C3: Adjust to available pins (e.g., GPIO6)

    config MODBUS_UART_BAUD_RATE
        int "UART Baud Rate"
        default 9600
        help
            Modbus RTU baud rate.
            Common values: 9600, 19200, 38400, 57600, 115200

    config MODBUS_SLAVE_ADDRESS
        int "Modbus Slave Address"
        default 1
        range 1 247
        help
            Modbus slave device address to communicate with.
            Valid range: 1-247

    config MODBUS_START_REGISTER
        hex "Starting Register Address"
        default 0x0000
        help
            First register address to read (hexadecimal).
            Example: 0x0000 for register 0

    config MODBUS_REGISTER_COUNT
        int "Number of Registers to Read"
        default 10
        range 1 125
        help
            Number of consecutive registers to read.
            Maximum: 125 (Modbus RTU limitation)

    config MODBUS_REQUEST_INTERVAL_MS
        int "Request Interval (ms)"
        default 1000
        range 100 60000
        help
            Time interval between Modbus requests in milliseconds.
            Minimum: 100ms (avoid flooding the bus)
            Default: 1000ms (1 second)

    config MODBUS_LED_GPIO
        int "Status LED GPIO"
        default 2
        help
            GPIO pin for status LED.
            - ESP32: GPIO2 (onboard LED)
            - ESP32-C3: GPIO8 (onboard LED)
            LED ON = successful read, OFF = error

    config MODBUS_ENABLE_DEBUG_LOGS
        bool "Enable Debug Logs"
        default n
        help
            Enable verbose Modbus debug logging.
            Shows hexdump of TX/RX frames.
            Disable in production to reduce log spam.

endmenu

menu "Modbus Function Code Support"

    config MODBUS_FC03_ENABLED
        bool "FC03: Read Holding Registers"
        default y
        help
            Enable Modbus function code 03 (Read Holding Registers).
            Required for this example.

    config MODBUS_FC04_ENABLED
        bool "FC04: Read Input Registers"
        default y
        help
            Enable Modbus function code 04 (Read Input Registers).

    config MODBUS_FC06_ENABLED
        bool "FC06: Write Single Register"
        default y
        help
            Enable Modbus function code 06 (Write Single Register).

    config MODBUS_FC16_ENABLED
        bool "FC16: Write Multiple Registers"
        default y
        help
            Enable Modbus function code 16 (Write Multiple Registers).

    config MODBUS_FC01_ENABLED
        bool "FC01: Read Coils"
        default n
        help
            Enable Modbus function code 01 (Read Coils).
            Disable to save flash space.

    config MODBUS_FC02_ENABLED
        bool "FC02: Read Discrete Inputs"
        default n
        help
            Enable Modbus function code 02 (Read Discrete Inputs).

    config MODBUS_FC05_ENABLED
        bool "FC05: Write Single Coil"
        default n
        help
            Enable Modbus function code 05 (Write Single Coil).

    config MODBUS_FC15_ENABLED
        bool "FC15: Write Multiple Coils"
        default n
        help
            Enable Modbus function code 15 (Write Multiple Coils).

endmenu

menu "Advanced Modbus Settings"

    config MODBUS_POLL_BUDGET
        int "Poll Budget (steps per iteration)"
        default 8
        range 1 256
        help
            Maximum number of state machine steps per poll iteration.
            Higher = lower latency but higher CPU usage.
            Lower = more CPU time for other tasks.
            Recommended: 8 for 9600 baud, 16 for 19200+

    config MODBUS_RESPONSE_TIMEOUT_MS
        int "Response Timeout (ms)"
        default 500
        range 50 5000
        help
            Maximum time to wait for Modbus response.
            Should be > (frame_size / baud_rate) * 1000
            Example: 256 bytes @ 9600 baud ≈ 267ms

    config MODBUS_RETRY_COUNT
        int "Retry Count on Error"
        default 2
        range 0 10
        help
            Number of retries on timeout/error.
            0 = no retry (fail immediately)

endmenu
```

## bak/examples/esp32_rtu_client/sdkconfig.defaults
```kconfig
# ESP32 Project Configuration (sdkconfig.defaults)
#
# This file sets default values for ESP-IDF configuration options.
# These can be overridden with 'idf.py menuconfig'.

# FreeRTOS Configuration
CONFIG_FREERTOS_HZ=1000
CONFIG_FREERTOS_UNICORE=n
CONFIG_FREERTOS_USE_TRACE_FACILITY=y
CONFIG_FREERTOS_GENERATE_RUN_TIME_STATS=y

# UART Driver Configuration
CONFIG_UART_ISR_IN_IRAM=y

# ESP Timer Configuration
CONFIG_ESP_TIMER_TASK_STACK_SIZE=4096

# Logging Configuration
CONFIG_LOG_DEFAULT_LEVEL_INFO=y
CONFIG_LOG_COLORS=y

# Compiler Options
CONFIG_COMPILER_OPTIMIZATION_SIZE=y
CONFIG_COMPILER_OPTIMIZATION_ASSERTIONS_ENABLE=y

# Memory Configuration
CONFIG_ESP_SYSTEM_EVENT_TASK_STACK_SIZE=2560

# Modbus Defaults (from Kconfig.projbuild)
CONFIG_MODBUS_UART_PORT=1
CONFIG_MODBUS_UART_TX_PIN=17
CONFIG_MODBUS_UART_RX_PIN=16
CONFIG_MODBUS_UART_BAUD_RATE=9600
CONFIG_MODBUS_SLAVE_ADDRESS=1
CONFIG_MODBUS_START_REGISTER=0x0000
CONFIG_MODBUS_REGISTER_COUNT=10
CONFIG_MODBUS_REQUEST_INTERVAL_MS=1000
CONFIG_MODBUS_LED_GPIO=2

# Modbus Function Codes
CONFIG_MODBUS_FC03_ENABLED=y
CONFIG_MODBUS_FC04_ENABLED=y
CONFIG_MODBUS_FC06_ENABLED=y
CONFIG_MODBUS_FC16_ENABLED=y

# Advanced Modbus Settings
CONFIG_MODBUS_POLL_BUDGET=8
CONFIG_MODBUS_RESPONSE_TIMEOUT_MS=500
CONFIG_MODBUS_RETRY_COUNT=2
```

## embedded/quickstarts/components/zephyr/zephyr/Kconfig.modbus
```kconfig
menu "Modbus quickstart"

config MODBUS_ZEPHYR_CLIENT_POOL_SIZE
    int "Client transaction pool size"
    range 1 32
    default 4
    help
        Number of transaction descriptors allocated by the quickstart helper.

config MODBUS_ZEPHYR_CLIENT_QUEUE_CAPACITY
    int "Client queue capacity override"
    range 0 32
    default 0
    help
        Optional override for mb_client_set_queue_capacity(). Leave zero to use
        the pool size.

config MODBUS_ZEPHYR_SOCKET_TIMEOUT_MS
    int "Socket receive timeout (ms)"
    range 0 5000
    default 20
    help
        Timeout passed to recv() when polling the TCP socket. A value of zero
        performs a pure non-blocking read.

config MODBUS_ZEPHYR_YIELD_MS
    int "Yield hint in milliseconds"
    range 0 20
    default 1
    help
        Delay used by the transport yield hook. Set to zero to call k_yield()
        instead of k_sleep().

endmenu
```
