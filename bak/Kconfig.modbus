## bak/Kconfig.modbus
```kconfig
# Kconfig.modbus - Zephyr Configuration for Modbus Library
#
# Copyright (c) 2025 Your Company
# SPDX-License-Identifier: Apache-2.0

menu "Modbus Configuration"

# ============================================================================
# Profile Selection
# ============================================================================

choice MODBUS_PROFILE
	prompt "Modbus Profile"
	default MODBUS_PROFILE_LEAN
	help
	  Select the Modbus feature profile:
	  
	  TINY  - Minimal footprint (~26KB ROM, ~8KB RAM)
	          Client-only, register operations (FC03/04/06/10/16/17)
	          Best for resource-constrained MCUs
	  
	  LEAN  - Balanced configuration (~40KB ROM, ~11KB RAM)
	          Client + Server, common function codes
	          Recommended for most applications
	  
	  FULL  - All features enabled (~43KB ROM, ~12KB RAM)
	          All function codes, diagnostics, full logging
	          Best for development and feature-rich applications

config MODBUS_PROFILE_TINY
	bool "TINY - Minimal footprint (register-only)"
	help
	  Minimal configuration: client-only, register operations,
	  RTU transport. Approximately 26KB ROM, 8KB RAM.

config MODBUS_PROFILE_LEAN
	bool "LEAN - Balanced (common FCs)"
	help
	  Balanced configuration: client + server, common function codes,
	  RTU + TCP transports. Approximately 40KB ROM, 11KB RAM.

config MODBUS_PROFILE_FULL
	bool "FULL - All features"
	help
	  Full-featured configuration: all function codes, diagnostics,
	  full logging support. Approximately 43KB ROM, 12KB RAM.

endchoice

config MODBUS_PROFILE
	int
	default 0 if MODBUS_PROFILE_TINY
	default 1 if MODBUS_PROFILE_LEAN
	default 2 if MODBUS_PROFILE_FULL

# ============================================================================
# Client / Server Mode
# ============================================================================

config MODBUS_ENABLE_CLIENT
	bool "Enable Modbus Client"
	default y
	help
	  Enable Modbus client (master) functionality. Allows this device
	  to initiate requests to Modbus servers.

config MODBUS_ENABLE_SERVER
	bool "Enable Modbus Server"
	default y if !MODBUS_PROFILE_TINY
	default n
	help
	  Enable Modbus server (slave) functionality. Allows this device
	  to respond to Modbus client requests.

# ============================================================================
# Transport Layer
# ============================================================================

menu "Transport Layer"

config MODBUS_TRANSPORT_RTU
	bool "Enable RTU Transport"
	default y
	help
	  Enable Modbus RTU (serial) transport. Requires UART hardware
	  and proper timing for character gaps (T1.5, T3.5).

config MODBUS_TRANSPORT_TCP
	bool "Enable TCP Transport"
	default y if !MODBUS_PROFILE_TINY
	default n
	select NET_SOCKETS if NETWORKING
	help
	  Enable Modbus TCP/IP transport. Requires TCP/IP stack.

config MODBUS_TRANSPORT_ASCII
	bool "Enable ASCII Transport"
	default n
	help
	  Enable Modbus ASCII transport. Less efficient than RTU,
	  but easier to debug with text-based tools.

endmenu # Transport Layer

# ============================================================================
# Function Codes
# ============================================================================

menu "Function Codes"

config MODBUS_ENABLE_FC01
	bool "FC01 - Read Coils"
	default y if MODBUS_PROFILE_FULL
	default n
	help
	  Enable support for reading discrete outputs (coils).

config MODBUS_ENABLE_FC02
	bool "FC02 - Read Discrete Inputs"
	default y if MODBUS_PROFILE_FULL
	default n
	help
	  Enable support for reading discrete inputs.

config MODBUS_ENABLE_FC03
	bool "FC03 - Read Holding Registers"
	default y
	help
	  Enable support for reading holding registers.
	  This is one of the most commonly used function codes.

config MODBUS_ENABLE_FC04
	bool "FC04 - Read Input Registers"
	default y
	help
	  Enable support for reading input registers.

config MODBUS_ENABLE_FC05
	bool "FC05 - Write Single Coil"
	default y if MODBUS_PROFILE_FULL
	default n
	help
	  Enable support for writing a single coil.

config MODBUS_ENABLE_FC06
	bool "FC06 - Write Single Register"
	default y
	help
	  Enable support for writing a single holding register.

config MODBUS_ENABLE_FC07
	bool "FC07 - Read Exception Status"
	default y if MODBUS_PROFILE_FULL
	default n
	help
	  Enable support for reading exception status (8 coils).

config MODBUS_ENABLE_FC0F
	bool "FC15 (0x0F) - Write Multiple Coils"
	default y if MODBUS_PROFILE_FULL
	default n
	help
	  Enable support for writing multiple coils.

config MODBUS_ENABLE_FC10
	bool "FC16 (0x10) - Write Multiple Registers"
	default y
	help
	  Enable support for writing multiple holding registers.

config MODBUS_ENABLE_FC11
	bool "FC17 (0x11) - Report Server ID"
	default y if MODBUS_PROFILE_FULL
	default n
	help
	  Enable support for reporting server identification.

config MODBUS_ENABLE_FC16
	bool "FC22 (0x16) - Mask Write Register"
	default y if MODBUS_PROFILE_FULL
	default n
	help
	  Enable support for mask write register operation.

config MODBUS_ENABLE_FC17
	bool "FC23 (0x17) - Read/Write Multiple Registers"
	default y
	help
	  Enable support for combined read/write operation.

endmenu # Function Codes

# ============================================================================
# Queue and Pool Configuration
# ============================================================================

menu "Queue and Pool Settings"

config MODBUS_QUEUE_DEPTH
	int "Transaction Queue Depth"
	range 4 64
	default 8 if MODBUS_PROFILE_TINY
	default 16 if MODBUS_PROFILE_LEAN
	default 32 if MODBUS_PROFILE_FULL
	help
	  Maximum number of pending transactions in the queue.
	  Higher values allow more concurrent requests but use more RAM.
	  
	  Recommended:
	  - TINY: 8 (saves RAM)
	  - LEAN: 16 (balanced)
	  - FULL: 32 (maximum throughput)

config MODBUS_MAX_PDU_SIZE
	int "Maximum PDU Size (bytes)"
	range 253 260
	default 253
	help
	  Maximum Modbus PDU size in bytes. Standard maximum is 253.
	  Increase only if you need non-standard extended frames.

config MODBUS_TX_POOL_SIZE
	int "TX Transaction Pool Size"
	range 4 64
	default 8 if MODBUS_PROFILE_TINY
	default 16 if MODBUS_PROFILE_LEAN
	default 32 if MODBUS_PROFILE_FULL
	help
	  Number of pre-allocated TX transaction structures.
	  Should be >= MODBUS_QUEUE_DEPTH.

endmenu # Queue and Pool Settings

# ============================================================================
# Timeouts and Timing
# ============================================================================

menu "Timeouts and Timing"

config MODBUS_DEFAULT_TIMEOUT_MS
	int "Default Transaction Timeout (ms)"
	range 100 10000
	default 1000
	help
	  Default timeout for Modbus transactions in milliseconds.
	  Can be overridden per transaction.

config MODBUS_INTER_FRAME_DELAY_MS
	int "Inter-frame Delay (ms)"
	range 0 1000
	default 10
	help
	  Minimum delay between consecutive frames.
	  Helps prevent overwhelming slow servers.

config MODBUS_RTU_T15_MULTIPLIER
	int "RTU T1.5 Multiplier (tenths)"
	range 10 30
	default 15
	depends on MODBUS_TRANSPORT_RTU
	help
	  T1.5 character time multiplier in tenths (1.5 = 15).
	  Used for detecting gaps between characters in a frame.

config MODBUS_RTU_T35_MULTIPLIER
	int "RTU T3.5 Multiplier (tenths)"
	range 30 50
	default 35
	depends on MODBUS_TRANSPORT_RTU
	help
	  T3.5 character time multiplier in tenths (3.5 = 35).
	  Used for detecting end of frame silence.

endmenu # Timeouts and Timing

# ============================================================================
# Diagnostics and Logging
# ============================================================================

menu "Diagnostics and Logging"

config MODBUS_ENABLE_DIAGNOSTICS
	bool "Enable Diagnostic Counters"
	default y if MODBUS_PROFILE_FULL
	default n
	help
	  Enable diagnostic counters for timeouts, CRC errors,
	  exceptions, and retries. Adds ~200 bytes RAM overhead.

config MODBUS_DIAG_ENABLE_COUNTERS
	bool "Enable Event Counters"
	default y if MODBUS_ENABLE_DIAGNOSTICS
	help
	  Track counts for various events (timeouts, CRC errors, etc).

config MODBUS_DIAG_ENABLE_TRACE
	bool "Enable Event Trace Buffer"
	default y if MODBUS_PROFILE_FULL
	default n
	help
	  Enable circular event trace buffer for debugging.

config MODBUS_DIAG_TRACE_DEPTH
	int "Trace Buffer Depth"
	range 16 256
	default 64
	depends on MODBUS_DIAG_ENABLE_TRACE
	help
	  Number of events to store in the trace buffer.

config MODBUS_LOG_LEVEL
	int "Logging Level"
	range 0 4
	default 0 if MODBUS_PROFILE_TINY
	default 2 if MODBUS_PROFILE_LEAN
	default 3 if MODBUS_PROFILE_FULL
	help
	  Modbus logging verbosity:
	  0 = None (smallest footprint)
	  1 = Errors only
	  2 = Warnings + Errors
	  3 = Info + Warnings + Errors
	  4 = Debug (all messages)

endmenu # Diagnostics and Logging

# ============================================================================
# Advanced Features
# ============================================================================

menu "Advanced Features"

config MODBUS_ENABLE_POWER_MANAGEMENT
	bool "Enable Power Management"
	default n
	help
	  Enable power management features including idle callbacks
	  and tickless operation support.

config MODBUS_PORT_MUTEX
	bool "Enable Port Layer Mutex Support"
	default y
	help
	  Enable mutex/semaphore support in port layer.
	  Required for thread-safe operation in RTOS environments.

config MODBUS_ENABLE_ISR_SAFE_MODE
	bool "Enable ISR-Safe Mode"
	default n
	help
	  Enable special handling for ISR context operations.
	  Allows TX/RX from ISR with minimal latency.

config MODBUS_ENABLE_ZERO_COPY
	bool "Enable Zero-Copy IO"
	default y if !MODBUS_PROFILE_TINY
	default n
	help
	  Enable zero-copy scatter-gather IO using iovec structures.
	  Reduces memory copies but adds slight complexity.

endmenu # Advanced Features

# ============================================================================
# Port Layer Configuration
# ============================================================================

menu "Port Layer"

config MODBUS_PORT_POSIX
	bool "Use POSIX Port Layer"
	default n
	help
	  Use POSIX implementation for sockets, threads, and time.
	  Suitable for Linux/Unix hosts.

config MODBUS_PORT_ZEPHYR
	bool "Use Zephyr Port Layer"
	default y
	help
	  Use Zephyr RTOS native implementation for sockets,
	  threads, and time.

endmenu # Port Layer

endmenu # Modbus Configuration
```
