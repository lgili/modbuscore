## embedded/quickstarts/components/zephyr/zephyr/samples/hello_tcp/sample.yaml
```yaml
sample:
  description: "Minimal Modbus/TCP client quickstart"
  name: modbus-hello-tcp
common:
  tags:
    - networking
    - modbus
  harness: net
  harness_config:
    type: net
    log_regex:
      - "Modbus poll"
```
