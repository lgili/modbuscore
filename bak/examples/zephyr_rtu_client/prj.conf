## CMakeLists.txt
```
# Copyright (c) 2025
# SPDX-License-Identifier: Apache-2.0

# =============================================================================
# CMakeLists.txt for Zephyr + Modbus RTU Client Example
# =============================================================================
# This file integrates the Modbus library with a Zephyr RTOS application.
#
# USAGE:
#   west build -b nrf52840dk_nrf52840
#   west flash
#   west build -b nucleo_f411re  (for STM32)
# =============================================================================

cmake_minimum_required(VERSION 3.20.0)

# Find Zephyr package (sets ZEPHYR_BASE, BOARD, etc.)
find_package(Zephyr REQUIRED HINTS $ENV{ZEPHYR_BASE})

# Define project
project(zephyr_modbus_rtu_client VERSION 1.0.0)

# =============================================================================
# APPLICATION SOURCES
# =============================================================================

# Main application file
target_sources(app PRIVATE src/main.c)

# =============================================================================
# MODBUS LIBRARY INTEGRATION
# =============================================================================

# Path to Modbus library (adjust relative path as needed)
set(MODBUS_DIR ${CMAKE_CURRENT_SOURCE_DIR}/../..)

# Modbus library sources
target_sources(app PRIVATE
    ${MODBUS_DIR}/modbus/src/mb_client.c
    ${MODBUS_DIR}/modbus/src/mb_transport_rtu.c
    ${MODBUS_DIR}/modbus/src/mb_crc.c
    ${MODBUS_DIR}/modbus/src/mb_err.c
    ${MODBUS_DIR}/modbus/src/mb_util.c
    # Add more sources as needed:
    # ${MODBUS_DIR}/modbus/src/mb_server.c
    # ${MODBUS_DIR}/modbus/src/mb_transport_tcp.c
)

# Modbus library include directories
target_include_directories(app PRIVATE
    ${MODBUS_DIR}/modbus/include
)

# Modbus compile definitions
target_compile_definitions(app PRIVATE
    # Profile selection (FULL, LEAN, TINY)
    MB_CONF_PROFILE=MB_PROFILE_LEAN
    
    # Function code enablement
    MB_CONF_ENABLE_FC03=1  # Read Holding Registers
    MB_CONF_ENABLE_FC04=1  # Read Input Registers
    MB_CONF_ENABLE_FC06=1  # Write Single Register
    MB_CONF_ENABLE_FC16=1  # Write Multiple Registers
    
    # Transport enablement
    MB_CONF_RTU_ENABLED=1
    MB_CONF_ASCII_ENABLED=0
    MB_CONF_TCP_ENABLED=0
)

# =============================================================================
# ZEPHYR-SPECIFIC CONFIGURATION
# =============================================================================

# Enable C11 standard (Modbus library requires stdint.h, stdbool.h)
target_compile_options(app PRIVATE
    -std=c11
    -Wall
    -Wextra
)

# =============================================================================
# DEVICETREE OVERLAY (optional, for custom UART pinout)
# =============================================================================
# If your board requires custom UART configuration, create:
#   boards/nrf52840dk_nrf52840.overlay
# or
#   boards/nucleo_f411re.overlay
#
# Example overlay content (nRF52840 DK):
#
# / {
#     aliases {
#         modbus-uart = &uart0;
#     };
# };
# 
# &uart0 {
#     status = "okay";
#     current-speed = <9600>;
#     tx-pin = <6>;  /* P0.06 */
#     rx-pin = <8>;  /* P0.08 */
# };
#
# For STM32 Nucleo:
# &usart1 {
#     status = "okay";
#     pinctrl-0 = <&usart1_tx_pa9 &usart1_rx_pa10>;
#     pinctrl-names = "default";
# };
# =============================================================================

# =============================================================================
# NOTES FOR PORTING
# =============================================================================
#
# 1. BOARD SELECTION:
#    Supported boards: Any Zephyr-supported board with UART
#    Examples:
#    - nRF52840 DK:        west build -b nrf52840dk_nrf52840
#    - STM32 Nucleo F4:    west build -b nucleo_f411re
#    - ESP32 DevKit:       west build -b esp32_devkitc_wroom
#    - QEMU (simulation):  west build -b qemu_cortex_m3
#
# 2. UART CONFIGURATION:
#    - Default: Uses first available UART (zephyr,console or uart0)
#    - For production: Create devicetree overlay to define modbus-uart alias
#    - See boards/ directory for examples
#
# 3. MEMORY REQUIREMENTS:
#    - RAM:  ~8 KB (heap + stacks + Modbus buffers)
#    - ROM:  ~20 KB (Zephyr kernel + Modbus lib + example)
#    - Test on target before production deployment
#
# 4. DEBUGGING:
#    - Enable CONFIG_DEBUG=y in prj.conf
#    - Use "west debug" to start GDB session
#    - Set breakpoints: (gdb) break main
#
# 5. PRODUCTION BUILD:
#    west build -b <board> -- -DCMAKE_BUILD_TYPE=Release
#    This enables -Os optimization and disables debug symbols
```

## prj.conf
```kconfig
# Copyright (c) 2025
# SPDX-License-Identifier: Apache-2.0

# =============================================================================
# Zephyr Project Configuration
# =============================================================================
# This file configures Zephyr kernel and subsystems for Modbus RTU client.
# Adjust settings based on your hardware (RAM/ROM constraints, peripherals).
# =============================================================================

# -----------------------------------------------------------------------------
# KERNEL CONFIGURATION
# -----------------------------------------------------------------------------

# Main thread stack size (default 1024 is sufficient for this example)
CONFIG_MAIN_STACK_SIZE=2048

# System workqueue stack size (for k_work_submit)
# Increase if Modbus polling requires more stack
CONFIG_SYSTEM_WORKQUEUE_STACK_SIZE=2048

# Enable thread name support (for debugging)
CONFIG_THREAD_NAME=y

# Thread runtime statistics (optional, for profiling)
# CONFIG_THREAD_RUNTIME_STATS=y

# -----------------------------------------------------------------------------
# MEMORY MANAGEMENT
# -----------------------------------------------------------------------------

# Heap size for dynamic allocation (k_malloc)
# Modbus library uses static buffers, so heap is mainly for Zephyr internals
CONFIG_HEAP_MEM_POOL_SIZE=4096

# Enable stack canaries for overflow detection (development only)
# Disable in production to save ROM
CONFIG_STACK_CANARIES=y

# -----------------------------------------------------------------------------
# LOGGING
# -----------------------------------------------------------------------------

# Enable logging subsystem
CONFIG_LOG=y

# Log level: 0=OFF, 1=ERR, 2=WRN, 3=INF, 4=DBG
CONFIG_LOG_DEFAULT_LEVEL=3

# Buffered logging (for better real-time performance)
CONFIG_LOG_MODE_DEFERRED=y

# Log buffer size (increase if logs are dropped)
CONFIG_LOG_BUFFER_SIZE=2048

# Enable hexdump support (for Modbus frame inspection)
CONFIG_LOG_BUFFER_SIZE=4096

# Log backend: UART (console)
CONFIG_LOG_BACKEND_UART=y

# Disable RTT backend (if not using Segger J-Link)
# CONFIG_LOG_BACKEND_RTT=n

# -----------------------------------------------------------------------------
# UART DRIVER
# -----------------------------------------------------------------------------

# Enable UART driver
CONFIG_UART=y

# Enable interrupt-driven UART API (required for uart_irq_callback_set)
CONFIG_UART_INTERRUPT_DRIVEN=y

# UART buffer sizes (for RX/TX FIFOs)
# Adjust based on Modbus frame size (max 256 bytes)
CONFIG_UART_0_NRF_TX_BUFFER_SIZE=256
CONFIG_UART_0_NRF_RX_BUFFER_SIZE=256

# Enable UART console (for LOG_BACKEND_UART)
CONFIG_CONSOLE=y
CONFIG_UART_CONSOLE=y

# -----------------------------------------------------------------------------
# GPIO DRIVER (for LED status indicator)
# -----------------------------------------------------------------------------

# Enable GPIO driver
CONFIG_GPIO=y

# -----------------------------------------------------------------------------
# MODBUS LIBRARY CONFIGURATION
# -----------------------------------------------------------------------------

# Modbus profile: LEAN (minimal features for client-only)
# Options: FULL, LEAN, TINY
CONFIG_MODBUS_PROFILE=LEAN

# Enable Modbus RTU transport
CONFIG_MODBUS_RTU_ENABLED=y

# Disable unused transports to save ROM
CONFIG_MODBUS_ASCII_ENABLED=n
CONFIG_MODBUS_TCP_ENABLED=n

# Enable Modbus function codes
CONFIG_MODBUS_FC03_ENABLED=y  # Read Holding Registers
CONFIG_MODBUS_FC04_ENABLED=y  # Read Input Registers
CONFIG_MODBUS_FC06_ENABLED=y  # Write Single Register
CONFIG_MODBUS_FC16_ENABLED=y  # Write Multiple Registers

# Disable server-only function codes to save ROM
CONFIG_MODBUS_FC01_ENABLED=n  # Read Coils
CONFIG_MODBUS_FC02_ENABLED=n  # Read Discrete Inputs
CONFIG_MODBUS_FC05_ENABLED=n  # Write Single Coil
CONFIG_MODBUS_FC15_ENABLED=n  # Write Multiple Coils

# -----------------------------------------------------------------------------
# TIMING AND TIMERS
# -----------------------------------------------------------------------------

# System tick frequency (Hz)
# 1000 Hz = 1ms tick (required for Modbus T1.5/T3.5 timing accuracy)
CONFIG_SYS_CLOCK_TICKS_PER_SEC=1000

# Enable kernel timers (k_timer_*)
CONFIG_TIMER=y

# -----------------------------------------------------------------------------
# NETWORKING (DISABLED - RTU uses UART, not TCP)
# -----------------------------------------------------------------------------

CONFIG_NETWORKING=n

# -----------------------------------------------------------------------------
# DEBUGGING (enable for development, disable for production)
# -----------------------------------------------------------------------------

# Enable assertions (catches bugs early)
# Disable in production to save ROM
CONFIG_ASSERT=y

# Enable DEBUG build (adds symbols, disables optimizations)
# For production, use "west build -b <board> -- -DCMAKE_BUILD_TYPE=Release"
# CONFIG_DEBUG=y

# Enable GDB stub (for remote debugging via JTAG)
# CONFIG_DEBUG_THREAD_INFO=y

# -----------------------------------------------------------------------------
# OPTIMIZATION
# -----------------------------------------------------------------------------

# Optimization level
# -Os: Optimize for size (default)
# -O2: Optimize for speed
# -O3: Aggressive optimization
CONFIG_SIZE_OPTIMIZATIONS=y

# Link-time optimization (LTO) - reduces ROM size by ~10%
# May increase build time
CONFIG_LTO=y

# Remove unused symbols
CONFIG_LINKER_ORPHAN_SECTION_PLACE=y

# -----------------------------------------------------------------------------
# POWER MANAGEMENT (optional, for battery-powered devices)
# -----------------------------------------------------------------------------

# Enable power management
# CONFIG_PM=y

# Enable device power management
# CONFIG_PM_DEVICE=y

# CPU idle sleep mode
# CONFIG_PM_POLICY_DEFAULT=y

# -----------------------------------------------------------------------------
# BOARD-SPECIFIC OVERRIDES
# -----------------------------------------------------------------------------

# Example for nRF52840 DK:
# - Use UART0 for Modbus
# - Use UART1 for console/logging (to avoid conflict)
# 
# In boards/nrf52840dk_nrf52840.overlay:
# / {
#     aliases {
#         modbus-uart = &uart0;
#         log-uart = &uart1;
#     };
# };

# Example for STM32 Nucleo F4:
# - Use USART1 for Modbus
# - Use USART2 for console (ST-Link virtual COM port)

# -----------------------------------------------------------------------------
# NOTES FOR CUSTOMIZATION
# -----------------------------------------------------------------------------

# 1. UART Configuration:
#    - Modbus requires dedicated UART (not shared with console)
#    - Use devicetree overlay to define "modbus-uart" alias
#    - Adjust baud rate in main.c (default 9600)
#
# 2. Memory Constraints:
#    - RAM usage: ~4KB heap + 2KB main stack + 2KB workqueue = 8KB total
#    - ROM usage: ~20KB (Zephyr kernel + Modbus lib + example code)
#    - For ultra-low-memory MCUs (<32KB RAM), reduce stack sizes
#
# 3. Real-Time Performance:
#    - CONFIG_SYS_CLOCK_TICKS_PER_SEC=1000 ensures 1ms timing accuracy
#    - Use CONFIG_PREEMPT_ENABLED=y (default) for responsive ISRs
#    - Consider CONFIG_TIMESLICING=n to reduce jitter
#
# 4. Logging in Production:
#    - Disable logging to save ROM/RAM: CONFIG_LOG=n
#    - Or set CONFIG_LOG_DEFAULT_LEVEL=1 (errors only)
#    - Use CONFIG_LOG_MODE_MINIMAL for smallest footprint
#
# 5. Power Optimization:
#    - Enable CONFIG_PM=y and implement idle hooks
#    - Use k_sleep() in app_thread to allow CPU to sleep
#    - Configure UART with wake-on-RX if supported by hardware
```

## src/main.c
```c
/**
 * @file main.c
 * @brief Zephyr RTOS + Modbus RTU Client Example
 * 
 * This example demonstrates production-ready integration of Modbus library
 * with Zephyr RTOS, showcasing:
 * - Workqueue-based polling (k_work_submit)
 * - Timer-driven periodic requests (k_timer)
 * - Mutex-protected shared data (k_mutex)
 * - UART callback integration (uart_irq_callback_set)
 * - Thread-safe logging (LOG_MODULE_REGISTER)
 * 
 * Architecture:
 *   UART ISR → Workqueue → mb_client_poll() → Callback → Update registers
 *              ↑
 *           k_timer (1 sec) → Send FC03 request
 * 
 * Target: nRF52840, STM32F4, ESP32, or any Zephyr-supported board with UART
 * 
 * Copyright (c) 2025
 * SPDX-License-Identifier: Apache-2.0
 */

#include <zephyr/kernel.h>
#include <zephyr/device.h>
#include <zephyr/drivers/uart.h>
#include <zephyr/drivers/gpio.h>
#include <zephyr/logging/log.h>

#include "modbus/client.h"
#include "modbus/transport/rtu.h"

LOG_MODULE_REGISTER(modbus_example, LOG_LEVEL_INF);

/* ===========================================================================
 * CONFIGURATION (adjust to your board in prj.conf)
 * =========================================================================== */

/* UART device (defined in devicetree: zephyr,shell-uart or custom overlay) */
#define UART_DEVICE_NODE DT_ALIAS(modbus_uart)
#if !DT_NODE_HAS_STATUS(UART_DEVICE_NODE, okay)
#error "Unsupported board: modbus_uart devicetree alias is not defined"
#endif

/* LED GPIO (optional, for status indication) */
#define LED_NODE DT_ALIAS(led0)
#if DT_NODE_HAS_STATUS(LED_NODE, okay)
#define HAS_LED 1
static const struct gpio_dt_spec led = GPIO_DT_SPEC_GET(LED_NODE, gpios);
#else
#define HAS_LED 0
#endif

/* Modbus configuration */
#define MODBUS_SLAVE_ADDR       1
#define MODBUS_START_REGISTER   0x0000
#define MODBUS_REGISTER_COUNT   10
#define REQUEST_INTERVAL_MS     1000
#define POLL_BUDGET             8  /* Max steps per workqueue iteration */

/* ===========================================================================
 * MODBUS CLIENT CONTEXT
 * =========================================================================== */

static mb_client_t client;
static mb_transport_rtu_t rtu_transport;

/* Modbus PDU buffer (256 bytes = max Modbus frame) */
static uint8_t tx_buffer[256];
static uint8_t rx_buffer[256];

/* Transport I/O buffers for RTU (T1.5/T3.5 timing) */
static uint8_t uart_tx_buf[256];
static uint8_t uart_rx_buf[256];
static size_t uart_rx_len = 0;

/* ===========================================================================
 * SHARED DATA (protected by mutex)
 * =========================================================================== */

K_MUTEX_DEFINE(register_mutex);
static uint16_t register_values[MODBUS_REGISTER_COUNT];
static volatile uint32_t successful_reads = 0;
static volatile uint32_t failed_reads = 0;

/* ===========================================================================
 * ZEPHYR WORKQUEUE AND TIMER
 * =========================================================================== */

/* Workqueue for Modbus polling (runs in thread context) */
static struct k_work modbus_poll_work;

/* Timer for periodic Modbus requests (1 second) */
static struct k_timer request_timer;

/* ===========================================================================
 * UART DEVICE
 * =========================================================================== */

static const struct device *uart_dev = DEVICE_DT_GET(UART_DEVICE_NODE);

/* ===========================================================================
 * TRANSPORT LAYER CALLBACKS
 * =========================================================================== */

/**
 * @brief Send data via UART
 * 
 * Called by Modbus RTU transport to transmit frame.
 * Blocks until all bytes are sent (polling mode for simplicity).
 * 
 * @param transport Transport instance
 * @param data Data to send
 * @param len Number of bytes
 * @return Number of bytes sent, or 0 on error
 */
static size_t transport_send(mb_transport_t *transport, const uint8_t *data, size_t len)
{
    (void)transport;
    
    if (!device_is_ready(uart_dev)) {
        LOG_ERR("UART device not ready");
        return 0;
    }
    
    /* Copy to UART TX buffer */
    if (len > sizeof(uart_tx_buf)) {
        LOG_ERR("TX buffer overflow: %zu > %zu", len, sizeof(uart_tx_buf));
        return 0;
    }
    memcpy(uart_tx_buf, data, len);
    
    /* Send via UART (polling mode) */
    for (size_t i = 0; i < len; i++) {
        uart_poll_out(uart_dev, uart_tx_buf[i]);
    }
    
    LOG_HEXDUMP_DBG(data, len, "TX");
    return len;
}

/**
 * @brief Receive data from UART
 * 
 * Called by Modbus RTU transport to read received bytes.
 * Returns data accumulated by UART ISR.
 * 
 * @param transport Transport instance
 * @param buffer Destination buffer
 * @param max_len Maximum bytes to read
 * @return Number of bytes read
 */
static size_t transport_recv(mb_transport_t *transport, uint8_t *buffer, size_t max_len)
{
    (void)transport;
    
    if (uart_rx_len == 0) {
        return 0;
    }
    
    size_t to_copy = (uart_rx_len < max_len) ? uart_rx_len : max_len;
    memcpy(buffer, uart_rx_buf, to_copy);
    
    /* Shift remaining bytes (if any) */
    if (to_copy < uart_rx_len) {
        memmove(uart_rx_buf, uart_rx_buf + to_copy, uart_rx_len - to_copy);
    }
    uart_rx_len -= to_copy;
    
    LOG_HEXDUMP_DBG(buffer, to_copy, "RX");
    return to_copy;
}

/**
 * @brief Get current timestamp in milliseconds
 * 
 * Used by Modbus RTU for T1.5/T3.5 timeout calculations.
 * 
 * @return Milliseconds since boot
 */
static uint32_t transport_get_time_ms(void)
{
    return k_uptime_get_32();
}

/**
 * @brief Idle/yield function (optional)
 * 
 * Called by Modbus library during long operations.
 * In Zephyr, we can yield to other threads.
 */
static void transport_yield(void)
{
    k_yield();
}

/* ===========================================================================
 * UART INTERRUPT HANDLER
 * =========================================================================== */

/**
 * @brief UART RX interrupt callback
 * 
 * Accumulates received bytes into uart_rx_buf.
 * After frame boundary (idle line or timeout), submits work to poll Modbus.
 * 
 * NOTE: This runs in ISR context - must be fast and non-blocking!
 */
static void uart_isr_callback(const struct device *dev, void *user_data)
{
    (void)user_data;
    
    if (!uart_irq_update(uart_dev)) {
        return;
    }
    
    /* RX data ready? */
    if (uart_irq_rx_ready(uart_dev)) {
        uint8_t byte;
        while (uart_fifo_read(uart_dev, &byte, 1) == 1) {
            if (uart_rx_len < sizeof(uart_rx_buf)) {
                uart_rx_buf[uart_rx_len++] = byte;
            } else {
                LOG_WRN("RX buffer overflow");
            }
        }
        
        /* Submit workqueue to process Modbus frame
         * Note: In production, you might want to use a timer to detect
         * frame boundary (T3.5 = 3.5 characters of silence) instead of
         * submitting work on every byte. For simplicity, we submit immediately.
         */
        k_work_submit(&modbus_poll_work);
    }
}

/* ===========================================================================
 * MODBUS CALLBACKS
 * =========================================================================== */

/**
 * @brief Callback for FC03 Read Holding Registers response
 * 
 * Called by Modbus client when FC03 response is received and validated.
 * Extracts register values and stores them in shared memory.
 * 
 * @param client Modbus client instance
 * @param req Request PDU (what we sent)
 * @param resp Response PDU (what we received)
 */
static void modbus_read_callback(mb_client_t *cli, const mb_pdu_t *req, const mb_pdu_t *resp)
{
    (void)cli;
    (void)req;
    
    /* Parse FC03 response format:
     * [Function Code: 1 byte] [Byte Count: 1 byte] [Register Data: N*2 bytes]
     */
    const uint8_t *resp_data = mb_pdu_get_data(resp);
    uint8_t byte_count = resp_data[0];
    uint16_t register_count = byte_count / 2;
    
    if (register_count > MODBUS_REGISTER_COUNT) {
        LOG_WRN("Response has more registers than expected: %u > %u",
                register_count, MODBUS_REGISTER_COUNT);
        register_count = MODBUS_REGISTER_COUNT;
    }
    
    /* Extract 16-bit registers (big-endian) */
    k_mutex_lock(&register_mutex, K_FOREVER);
    
    for (uint16_t i = 0; i < register_count; i++) {
        register_values[i] = (resp_data[1 + i*2] << 8) | resp_data[1 + i*2 + 1];
    }
    
    k_mutex_unlock(&register_mutex);
    
    successful_reads++;
    
    LOG_INF("FC03 Success - Registers 0x%04X..0x%04X read",
            MODBUS_START_REGISTER,
            MODBUS_START_REGISTER + register_count - 1);
    
#if HAS_LED
    gpio_pin_set_dt(&led, 1);  /* LED ON = success */
#endif
}

/**
 * @brief Callback for Modbus errors
 * 
 * Called when request times out or receives exception response.
 * 
 * @param client Modbus client instance
 * @param req Request PDU
 * @param error Error code
 */
static void modbus_error_callback(mb_client_t *cli, const mb_pdu_t *req, mb_error_t error)
{
    (void)cli;
    (void)req;
    
    failed_reads++;
    
    LOG_ERR("Modbus error: %d (%s)", error, mb_error_to_string(error));
    
#if HAS_LED
    gpio_pin_set_dt(&led, 0);  /* LED OFF = error */
#endif
}

/* ===========================================================================
 * WORKQUEUE HANDLER (Modbus Polling)
 * =========================================================================== */

/**
 * @brief Workqueue handler for Modbus polling
 * 
 * Called from system workqueue when UART RX data is available.
 * Processes received bytes, validates frames, triggers callbacks.
 * 
 * Uses budget-based polling to prevent CPU starvation.
 */
static void modbus_poll_work_handler(struct k_work *work)
{
    (void)work;
    
    /* Poll client with budget (max 8 steps)
     * Each step processes ~1 byte or 1 state machine transition
     * Budget prevents blocking other threads for too long
     */
    mb_client_poll_with_budget(&client, POLL_BUDGET);
}

/* ===========================================================================
 * TIMER HANDLER (Periodic Modbus Requests)
 * =========================================================================== */

/**
 * @brief Timer callback for periodic FC03 requests
 * 
 * Sends Modbus FC03 (Read Holding Registers) request every 1 second.
 * Runs in timer ISR context - must be fast!
 */
static void request_timer_handler(struct k_timer *timer)
{
    (void)timer;
    
    /* Build FC03 request:
     * [Slave Address] [Function Code=0x03] [Start Addr High] [Start Addr Low]
     * [Register Count High] [Register Count Low] [CRC16]
     */
    mb_pdu_t *req = mb_client_get_request_buffer(&client);
    
    uint8_t *pdu = mb_pdu_get_data(req);
    pdu[0] = 0x03;  /* FC03: Read Holding Registers */
    pdu[1] = (MODBUS_START_REGISTER >> 8) & 0xFF;  /* Start address high */
    pdu[2] = MODBUS_START_REGISTER & 0xFF;         /* Start address low */
    pdu[3] = (MODBUS_REGISTER_COUNT >> 8) & 0xFF;  /* Register count high */
    pdu[4] = MODBUS_REGISTER_COUNT & 0xFF;         /* Register count low */
    
    mb_pdu_set_data_len(req, 5);
    
    /* Send request (async) */
    mb_error_t err = mb_client_send_request(&client, MODBUS_SLAVE_ADDR, req,
                                             modbus_read_callback,
                                             modbus_error_callback,
                                             500);  /* 500ms timeout */
    
    if (err != MB_OK) {
        LOG_ERR("Failed to send FC03 request: %d", err);
    }
}

/* ===========================================================================
 * APPLICATION LOGIC (runs in main thread)
 * =========================================================================== */

/**
 * @brief Application thread - processes register values
 * 
 * In a real application, this would:
 * - Control outputs based on register values
 * - Log data to flash/cloud
 * - Implement business logic
 * 
 * For this example, we just print values periodically.
 */
static void app_thread(void)
{
    while (1) {
        k_sleep(K_SECONDS(5));
        
        /* Read register values under mutex protection */
        k_mutex_lock(&register_mutex, K_FOREVER);
        
        LOG_INF("=== Modbus Statistics ===");
        LOG_INF("Successful reads: %u", successful_reads);
        LOG_INF("Failed reads: %u", failed_reads);
        LOG_INF("Register values:");
        for (int i = 0; i < MODBUS_REGISTER_COUNT; i++) {
            LOG_INF("  [%04X] = 0x%04X (%u)",
                    MODBUS_START_REGISTER + i,
                    register_values[i],
                    register_values[i]);
        }
        
        k_mutex_unlock(&register_mutex);
    }
}

/* ===========================================================================
 * MAIN - INITIALIZATION
 * =========================================================================== */

int main(void)
{
    LOG_INF("=== Zephyr + Modbus RTU Client Example ===");
    LOG_INF("Built: %s %s", __DATE__, __TIME__);
    
    /* -----------------------------------------------------------------------
     * 1. Initialize LED (optional)
     * ----------------------------------------------------------------------- */
#if HAS_LED
    if (!gpio_is_ready_dt(&led)) {
        LOG_WRN("LED device not ready");
    } else {
        gpio_pin_configure_dt(&led, GPIO_OUTPUT_INACTIVE);
        LOG_INF("LED initialized on pin %d", led.pin);
    }
#endif
    
    /* -----------------------------------------------------------------------
     * 2. Initialize UART
     * ----------------------------------------------------------------------- */
    if (!device_is_ready(uart_dev)) {
        LOG_ERR("UART device not ready");
        return -1;
    }
    
    /* Configure UART: 9600 baud, 8N1 (set in prj.conf or devicetree) */
    struct uart_config uart_cfg = {
        .baudrate = 9600,
        .parity = UART_CFG_PARITY_NONE,
        .stop_bits = UART_CFG_STOP_BITS_1,
        .data_bits = UART_CFG_DATA_BITS_8,
        .flow_ctrl = UART_CFG_FLOW_CTRL_NONE,
    };
    
    int ret = uart_configure(uart_dev, &uart_cfg);
    if (ret != 0) {
        LOG_ERR("Failed to configure UART: %d", ret);
        return -1;
    }
    
    /* Enable RX interrupt */
    uart_irq_callback_set(uart_dev, uart_isr_callback);
    uart_irq_rx_enable(uart_dev);
    
    LOG_INF("UART initialized: 9600 8N1");
    
    /* -----------------------------------------------------------------------
     * 3. Initialize Modbus RTU Transport
     * ----------------------------------------------------------------------- */
    mb_transport_rtu_config_t rtu_config = {
        .baudrate = 9600,
        .parity = MB_PARITY_NONE,
        .stop_bits = 1,
    };
    
    mb_error_t err = mb_transport_rtu_init(&rtu_transport, &rtu_config);
    if (err != MB_OK) {
        LOG_ERR("Failed to init RTU transport: %d", err);
        return -1;
    }
    
    /* Set transport callbacks */
    rtu_transport.base.send = transport_send;
    rtu_transport.base.recv = transport_recv;
    rtu_transport.base.get_time_ms = transport_get_time_ms;
    rtu_transport.base.yield = transport_yield;
    
    LOG_INF("Modbus RTU transport initialized");
    
    /* -----------------------------------------------------------------------
     * 4. Initialize Modbus Client
     * ----------------------------------------------------------------------- */
    mb_client_config_t client_config = {
        .transport = &rtu_transport.base,
        .tx_buffer = tx_buffer,
        .tx_buffer_size = sizeof(tx_buffer),
        .rx_buffer = rx_buffer,
        .rx_buffer_size = sizeof(rx_buffer),
    };
    
    err = mb_client_init(&client, &client_config);
    if (err != MB_OK) {
        LOG_ERR("Failed to init Modbus client: %d", err);
        return -1;
    }
    
    LOG_INF("Modbus client initialized");
    
    /* -----------------------------------------------------------------------
     * 5. Initialize Workqueue and Timer
     * ----------------------------------------------------------------------- */
    k_work_init(&modbus_poll_work, modbus_poll_work_handler);
    k_timer_init(&request_timer, request_timer_handler, NULL);
    
    /* Start timer (periodic, 1 second interval) */
    k_timer_start(&request_timer, K_MSEC(REQUEST_INTERVAL_MS),
                  K_MSEC(REQUEST_INTERVAL_MS));
    
    LOG_INF("Modbus request timer started (%d ms interval)", REQUEST_INTERVAL_MS);
    
    /* -----------------------------------------------------------------------
     * 6. Run Application Thread
     * ----------------------------------------------------------------------- */
    LOG_INF("Initialization complete - entering main loop");
    
    app_thread();  /* Never returns */
    
    return 0;
}
```
