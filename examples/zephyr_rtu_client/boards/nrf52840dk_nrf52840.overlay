/*
 * Copyright (c) 2025
 * SPDX-License-Identifier: Apache-2.0
 */

/ {
    aliases {
        /* Alias for Modbus UART device */
        modbus-uart = &uart0;
    };
};

/* Configure UART0 for Modbus communication */
&uart0 {
    status = "okay";
    current-speed = <9600>;
    
    /* nRF52840 DK default pins:
     * TX: P0.06
     * RX: P0.08
     * 
     * For custom wiring, adjust these pins:
     */
    tx-pin = <6>;
    rx-pin = <8>;
    
    /* Hardware flow control (optional, usually not needed for Modbus RTU) */
    /* rts-pin = <5>; */
    /* cts-pin = <7>; */
};

/* LED0 for status indication (optional) */
&led0 {
    status = "okay";
};
