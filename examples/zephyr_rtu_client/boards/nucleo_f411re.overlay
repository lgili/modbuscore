/*
 * Copyright (c) 2025
 * SPDX-License-Identifier: Apache-2.0
 */

/ {
    aliases {
        /* Alias for Modbus UART device (USART1 on STM32) */
        modbus-uart = &usart1;
    };
};

/* Configure USART1 for Modbus communication
 * 
 * STM32 Nucleo F411RE pinout:
 * - USART1_TX: PA9  (Arduino D8, CN10 pin 21)
 * - USART1_RX: PA10 (Arduino D2, CN10 pin 33)
 * 
 * Note: USART2 is used by ST-Link virtual COM port (console/logging)
 */
&usart1 {
    status = "okay";
    current-speed = <9600>;
    pinctrl-0 = <&usart1_tx_pa9 &usart1_rx_pa10>;
    pinctrl-names = "default";
};

/* LED (LD2 - green LED on Nucleo board) */
&green_led_2 {
    status = "okay";
};
